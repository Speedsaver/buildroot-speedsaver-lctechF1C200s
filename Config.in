## configs/speedsaver_defconfig
```kconfig
BR2_arm=y
BR2_ARM_INSTRUCTIONS_THUMB=y
BR2_CCACHE=y
BR2_PER_PACKAGE_DIRECTORIES=y
BR2_TOOLCHAIN_EXTERNAL=y
BR2_TOOLCHAIN_EXTERNAL_BOOTLIN=y
BR2_TOOLCHAIN_EXTERNAL_GDB_SERVER_COPY=y
BR2_TARGET_GENERIC_HOSTNAME="speedsaver"
BR2_TARGET_GENERIC_ISSUE="Welcome to Speedsaver"
BR2_INIT_SYSTEMD=y
BR2_TARGET_GENERIC_ROOT_PASSWD="navit"
BR2_SYSTEM_BIN_SH_BASH=y
# BR2_TARGET_GENERIC_REMOUNT_ROOTFS_RW is not set
BR2_SYSTEM_DEFAULT_PATH="/bin:/sbin:/usr/bin:/usr/sbin"
BR2_ROOTFS_OVERLAY="$(BR2_EXTERNAL_SPEEDSAVER_MANGOPI_PATH)/board/widora/mangopi/r3/rootfs"
BR2_ROOTFS_POST_BUILD_SCRIPT="$(BR2_EXTERNAL_SPEEDSAVER_MANGOPI_PATH)/board/widora/mangopi/r3/scripts/post-build.sh"
BR2_ROOTFS_POST_IMAGE_SCRIPT="$(BR2_EXTERNAL_SPEEDSAVER_MANGOPI_PATH)/board/allwinner/suniv-f1c100s/scripts/genimage.sh"
BR2_ROOTFS_POST_SCRIPT_ARGS="${BR2_TARGET_UBOOT_SPL_NAME}"
BR2_LINUX_KERNEL=y
BR2_LINUX_KERNEL_CUSTOM_VERSION=y
BR2_LINUX_KERNEL_CUSTOM_VERSION_VALUE="5.4.99"
BR2_LINUX_KERNEL_PATCH="$(BR2_EXTERNAL_SPEEDSAVER_MANGOPI_PATH)/board/allwinner/suniv-f1c100s/patch/linux"
BR2_LINUX_KERNEL_USE_CUSTOM_CONFIG=y
BR2_LINUX_KERNEL_CUSTOM_CONFIG_FILE="$(BR2_EXTERNAL_SPEEDSAVER_MANGOPI_PATH)/board/allwinner/suniv-f1c100s/linux.defconfig"
BR2_LINUX_KERNEL_XZ=y
BR2_LINUX_KERNEL_DTS_SUPPORT=y
BR2_LINUX_KERNEL_CUSTOM_DTS_PATH="$(BR2_EXTERNAL_SPEEDSAVER_MANGOPI_PATH)/board/allwinner/suniv-f1c100s/devicetree/linux/suniv-f1c100s.dtsi $(BR2_EXTERNAL_SPEEDSAVER_MANGOPI_PATH)/board/widora/mangopi/r3/devicetree/linux/devicetree.dts"
BR2_LINUX_KERNEL_INSTALL_TARGET=y
# BR2_PACKAGE_BUSYBOX is not set
BR2_PACKAGE_ALSA_UTILS=y
BR2_PACKAGE_ALSA_UTILS_AMIXER=y
BR2_PACKAGE_ALSA_UTILS_APLAY=y
BR2_PACKAGE_ALSA_UTILS_SPEAKER_TEST=y
BR2_PACKAGE_GZIP=y
BR2_PACKAGE_XZ=y
BR2_PACKAGE_GDB=y
BR2_PACKAGE_MTD=y
# BR2_PACKAGE_MTD_FLASHCP is not set
BR2_PACKAGE_MTD_MKFSUBIFS=y
BR2_PACKAGE_MTD_MTDPART=y
BR2_PACKAGE_I2C_TOOLS=y
BR2_PACKAGE_LIBUBOOTENV=y
BR2_PACKAGE_UMTPRD=y
BR2_PACKAGE_TINYALSA=y
BR2_PACKAGE_OPENSSL=y
BR2_PACKAGE_FREETYPE=y
BR2_PACKAGE_GD=y
BR2_PACKAGE_JPEG=y
BR2_PACKAGE_LIBPNG=y
BR2_PACKAGE_JITTERENTROPY_LIBRARY=y
BR2_PACKAGE_LIBV4L=y
BR2_PACKAGE_LIBV4L_UTILS=y
BR2_PACKAGE_TSLIB=y
BR2_PACKAGE_CHRONY=y
# BR2_PACKAGE_IFUPDOWN_SCRIPTS is not set
BR2_PACKAGE_BASH_COMPLETION=y
BR2_PACKAGE_FILE=y
BR2_PACKAGE_WHICH=y
BR2_PACKAGE_ACL=y
BR2_PACKAGE_COREUTILS=y
BR2_PACKAGE_PROCPS_NG=y
BR2_PACKAGE_PSMISC=y
BR2_PACKAGE_SYSTEMD_ANALYZE=y
# BR2_PACKAGE_SYSTEMD_PSTORE is not set
BR2_PACKAGE_SYSTEMD_FIRSTBOOT=y
# BR2_PACKAGE_SYSTEMD_HWDB is not set
BR2_PACKAGE_SYSTEMD_LOGIND=y
# BR2_PACKAGE_SYSTEMD_NETWORKD is not set
BR2_PACKAGE_SYSTEMD_OOMD=y
BR2_PACKAGE_SYSTEMD_RANDOMSEED=y
# BR2_PACKAGE_SYSTEMD_RESOLVED is not set
# BR2_PACKAGE_SYSTEMD_TIMEDATED is not set
# BR2_PACKAGE_SYSTEMD_TIMESYNCD is not set
# BR2_PACKAGE_SYSTEMD_VCONSOLE is not set
BR2_PACKAGE_TAR=y
BR2_PACKAGE_UTIL_LINUX_BINARIES=y
BR2_PACKAGE_UTIL_LINUX_FALLOCATE=y
BR2_PACKAGE_UTIL_LINUX_LOGIN=y
BR2_PACKAGE_UTIL_LINUX_LOSETUP=y
BR2_PACKAGE_UTIL_LINUX_NOLOGIN=y
BR2_PACKAGE_UTIL_LINUX_RUNUSER=y
BR2_PACKAGE_UTIL_LINUX_SCHEDUTILS=y
BR2_PACKAGE_UTIL_LINUX_SULOGIN=y
BR2_PACKAGE_UTIL_LINUX_UUIDD=y
# BR2_TARGET_ROOTFS_TAR is not set
BR2_TARGET_ROOTFS_UBI=y
BR2_TARGET_ROOTFS_UBI_SUBSIZE=2048
BR2_TARGET_ROOTFS_UBIFS_LEBSIZE=0x1f000
BR2_TARGET_ROOTFS_UBIFS_OPTS="-F"
BR2_TARGET_UBOOT=y
BR2_TARGET_UBOOT_BUILD_SYSTEM_KCONFIG=y
BR2_TARGET_UBOOT_CUSTOM_VERSION=y
BR2_TARGET_UBOOT_CUSTOM_VERSION_VALUE="2020.07"
BR2_TARGET_UBOOT_PATCH="$(BR2_EXTERNAL_SPEEDSAVER_MANGOPI_PATH)/board/allwinner/suniv-f1c100s/patch/u-boot"
BR2_TARGET_UBOOT_USE_CUSTOM_CONFIG=y
BR2_TARGET_UBOOT_CUSTOM_CONFIG_FILE="$(BR2_EXTERNAL_SPEEDSAVER_MANGOPI_PATH)/board/widora/mangopi/r3/uboot.defconfig"
BR2_TARGET_UBOOT_NEEDS_DTC=y
BR2_TARGET_UBOOT_NEEDS_PYLIBFDT=y
BR2_TARGET_UBOOT_SPL=y
BR2_TARGET_UBOOT_SPL_NAME="u-boot-sunxi-with-spl.bin"
BR2_TARGET_UBOOT_CUSTOM_DTS_PATH="$(BR2_EXTERNAL_SPEEDSAVER_MANGOPI_PATH)/board/allwinner/suniv-f1c100s/devicetree/uboot/suniv-f1c100s.dtsi $(BR2_EXTERNAL_SPEEDSAVER_MANGOPI_PATH)/board/widora/mangopi/r3/devicetree/uboot/suniv-f1c100s-generic.dts"
BR2_PACKAGE_HOST_DOSFSTOOLS=y
BR2_PACKAGE_HOST_E2FSPROGS=y
BR2_PACKAGE_HOST_GENIMAGE=y
BR2_PACKAGE_HOST_MTOOLS=y
BR2_PACKAGE_HOST_PYTHON3=y
BR2_PACKAGE_HOST_PYTHON3_SSL=y
BR2_PACKAGE_HOST_UBOOT_TOOLS=y
BR2_PACKAGE_HOST_UBOOT_TOOLS_FIT_SUPPORT=y
BR2_PACKAGE_HOST_UBOOT_TOOLS_FIT_SIGNATURE_SUPPORT=y
BR2_PACKAGE_NAVIT=y
BR2_PACKAGE_NAVIT_SPEEDSAVER=y
BR2_PACKAGE_NAVIT_VEHICLE_GPSD=y
```

## packages/Config.in
```kconfig
menu "Target packages"

menu "Userspace utilities"

source "$BR2_EXTERNAL_SPEEDSAVER_MANGOPI_PATH/packages/arduipi-oled/Config.in"
source "$BR2_EXTERNAL_SPEEDSAVER_MANGOPI_PATH/packages/curtail/Config.in"
source "$BR2_EXTERNAL_SPEEDSAVER_MANGOPI_PATH/packages/navit/Config.in"

endmenu

endmenu
```

## packages/arduipi-oled/Config.in
```kconfig
config BR2_PACKAGE_ARDUIPI_OLED
	bool "ArduiPi_OLED"
	depends on BR2_PACKAGE_I2C_TOOLS
	help
	  Arduipi_OLED library from Hallard.

	  https://github.com/hallard/ArduiPi_OLED
```

## packages/curtail/Config.in
```kconfig
config BR2_PACKAGE_CURTAIL
	bool "curtail"
	help
	  Curtail is a utility program that reads
	  stdin and writes to a file bound by size.

	  https://github.com/Comcast/Infinite-File-Curtailer
```

## packages/navit/Config.in
```kconfig
config BR2_PACKAGE_NAVIT
	bool "navit"
	help
	  The OpenSource vector based navigation software

	  http://www.navit-project.org

if BR2_PACKAGE_NAVIT

config BR2_PACKAGE_NAVIT_GTK2
	bool "enable GTK2 graphics driver"
	select BR2_PACKAGE_LIBGTK2
	select BR2_PACKAGE_XORG7
	help
	  Enable the gtk2 (gtk_drawing_area) graphics driver

config BR2_PACKAGE_NAVIT_QT5
	bool "enable QT5 graphics driver"
	select BR2_PACKAGE_QT5DECLARATIVE
	select BR2_PACKAGE_QT5DECLARATIVE_QUICK
	select BR2_PACKAGE_QT5SVG
	help
	  Enable the QT5 (qml2) graphics driver

config BR2_PACKAGE_NAVIT_SPEEDSAVER
	bool "enable the speedsaver build"
	select BR2_PACKAGE_ARDUIPI_OLED
	select BR2_PACKAGE_LIBGLIB2
	help
	  Enable the speedsaver build

config BR2_PACKAGE_NAVIT_SPOTIFY_PLAYER
	bool "enabled spotify player"
	select BR2_PACKAGE_ALSA_LIB
	select BR2_PACKAGE_LIBSPOTIFY
	help
	  Enable spotify player and alsa output

config BR2_PACKAGE_NAVIT_J1850_PLUGIN
	bool "enabled the j1850 plugin"
	help
	  Enable the SAE-J1850 plugin

config BR2_PACKAGE_NAVIT_VEHICLE_GPSD
	bool "enabled gpsd vehicle"
	select BR2_PACKAGE_GPSD
	help
	  Enable the GPSD vehicle

endif
```
