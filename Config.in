## board/allwinner/suniv-f1c100s/linux.defconfig
```kconfig
#
# Compiler: arm-buildroot-linux-gnueabi-gcc.br_real (Buildroot -gdc2423a-dirty) 8.4.0
#
CONFIG_CLANG_VERSION=0
CONFIG_CC_OPTIMIZE_FOR_SIZE=y


#
# General setup
#
# CONFIG_LOCALVERSION_AUTO is not set
CONFIG_SYSVIPC=y
CONFIG_POSIX_MQUEUE=y

#
# IRQ subsystem
#
# end of IRQ subsystem

#
# Timers subsystem
#
CONFIG_NO_HZ=y
CONFIG_HIGH_RES_TIMERS=y
# end of Timers subsystem

#
# RCU Subsystem
#
# end of RCU Subsystem

CONFIG_IKCONFIG=y
CONFIG_IKCONFIG_PROC=y

#
# Scheduler features
#
# end of Scheduler features

CONFIG_CGROUPS=y
CONFIG_MEMCG=y
CONFIG_MEMCG_SWAP=y
CONFIG_BLK_CGROUP=y
CONFIG_CGROUP_SCHED=y
CONFIG_CGROUP_PIDS=y
CONFIG_CGROUP_RDMA=y
CONFIG_CGROUP_DEVICE=y
CONFIG_CGROUP_CPUACCT=y
CONFIG_CGROUP_PERF=y
CONFIG_NAMESPACES=y
CONFIG_USER_NS=y
# CONFIG_KALLSYMS is not set
CONFIG_EMBEDDED=y
CONFIG_BLK=y
CONFIG_EXPERT=y

#
# Kernel Performance Events And Counters
#
CONFIG_PERF_EVENTS=y
# end of Kernel Performance Events And Counters

# end of General setup

CONFIG_ARM=y

#
# System Type
#

#
# Multiple platform selection
#

#
# CPU Core family selection
#
CONFIG_ARCH_MULTI_V5=y
# CONFIG_ARCH_MULTI_V7 is not set
CONFIG_ARCH_SUNXI=y

#
# Processor Type
#

#
# Processor Features
#
# end of System Type

#
# Bus support
#
# end of Bus support

#
# Kernel Features
#
CONFIG_AEABI=y
CONFIG_OABI_COMPAT=y
# CONFIG_ARM_MODULE_PLTS is not set

#
# Boot options
#
CONFIG_ARM_APPENDED_DTB=y
CONFIG_ARM_ATAG_DTB_COMPAT=y
CONFIG_CMDLINE="net.ifnames=0 vt.global_cursor_default=0"
CONFIG_CMDLINE_EXTEND=y
# end of Boot options

#
# CPU Power Management
#

#
# CPU Frequency scaling
#
CONFIG_CPU_FREQ=y

#
# CPU frequency scaling drivers
#
CONFIG_CPUFREQ_DT=y
# end of CPU Frequency scaling

#
# CPU Idle
#
CONFIG_CPU_IDLE=y
# end of ARM CPU Idle Drivers
# end of CPU Idle
# end of CPU Power Management

#
# ARM CPU Idle Drivers
#
CONFIG_ARM_CPUIDLE=y

#
# Floating point emulation
#

#
# At least one emulation must be selected
#
CONFIG_FPE_NWFPE=y
# end of Floating point emulation

#
# Power management options
#
# end of Power management options

#
# Firmware Drivers
#

#
# Tegra firmware driver
#
# end of Tegra firmware driver
# end of Firmware Drivers

#
# General architecture-dependent options
#
CONFIG_CLONE_BACKWARDS=y
CONFIG_STRICT_KERNEL_RWX=y
CONFIG_STRICT_MODULE_RWX=y

#
# GCOV-based kernel profiling
#
# end of GCOV-based kernel profiling

# end of General architecture-dependent options

CONFIG_MODULES=y
CONFIG_MODULE_UNLOAD=y

CONFIG_BLOCK=y

#
# Memory Management options
#
CONFIG_CMA=y
# end of Memory Management options

CONFIG_NET=y

#
# Networking options
#
CONFIG_PACKET=y
CONFIG_UNIX=y
CONFIG_INET=y
CONFIG_IPV6=m

#
# Network testing
#
# end of Network testing
# end of Networking options

# CONFIG_WIRELESS is not set

#
# Device Drivers
#

#
# Generic Driver Options
#
CONFIG_UEVENT_HELPER=y
CONFIG_DEVTMPFS=y
CONFIG_DEVTMPFS_MOUNT=y

#
# Firmware loader
#
# end of Firmware loader

# end of Generic Driver Options

#
# Bus devices
#
CONFIG_SUNXI_RSB=y
# end of Bus devices

CONFIG_MTD=y

#
# Partition parsers
#
CONFIG_MTD_CMDLINE_PARTS=y
# end of Partition parsers

#
# User Modules And Translation Layers
#
CONFIG_MTD_BLOCK=y

#
# RAM/ROM/Flash chip drivers
#
# end of RAM/ROM/Flash chip drivers

#
# Mapping drivers for chip access
#
# end of Mapping drivers for chip access

#
# Self-contained MTD device drivers
#

#
# Disk-On-Chip Device Drivers
#
# end of Self-contained MTD device drivers

#
# LPDDR & LPDDR2 PCM memory drivers
#
# end of LPDDR & LPDDR2 PCM memory drivers

CONFIG_MTD_SPI_NAND=y
CONFIG_MTD_UBI=y
CONFIG_BLK_DEV_LOOP=y
CONFIG_BLK_DEV_LOOP_MIN_COUNT=2

#
# Input device support
#
CONFIG_INPUT_POLLDEV=y

#
# Userland interfaces
#
CONFIG_INPUT_EVDEV=y

#
# Input Device Drivers
#
# CONFIG_KEYBOARD_ATKBD is not set
CONFIG_KEYBOARD_SUN4I_LRADC=y
# CONFIG_INPUT_MOUSE is not set
CONFIG_INPUT_TOUCHSCREEN=y
CONFIG_TOUCHSCREEN_GOODIX=m
CONFIG_TOUCHSCREEN_TSC2007=m

#
# Hardware I/O ports
#
# CONFIG_SERIO_SERPORT is not set
# end of Hardware I/O ports
# end of Input device support

#
# Character devices
#
CONFIG_VT_HW_CONSOLE_BINDING=y
# CONFIG_LEGACY_PTYS is not set

#
# Serial drivers
#
CONFIG_SERIAL_8250=y
CONFIG_SERIAL_8250_CONSOLE=y
CONFIG_SERIAL_8250_NR_UARTS=8
CONFIG_SERIAL_8250_RUNTIME_UARTS=8
CONFIG_SERIAL_8250_DW=y
CONFIG_SERIAL_OF_PLATFORM=y

#
# Non-8250 serial port support
#
# end of Serial drivers

# CONFIG_HW_RANDOM is not set

#
# I2C support
#
CONFIG_I2C=y
CONFIG_I2C_CHARDEV=y
CONFIG_I2C_MUX=y

#
# Multiplexer I2C Chip support
#
# end of Multiplexer I2C Chip support

#
# I2C Hardware Bus support
#

#
# I2C system bus drivers (mostly embedded / system-on-chip)
#
CONFIG_I2C_MV64XXX=y


#
# External I2C/SMBus adapter drivers
#

#
# Other I2C/SMBus bus drivers
#
# end of I2C Hardware Bus support
# end of I2C support

#
# SPI Master Controller Drivers
#
CONFIG_SPI=y
CONFIG_SPI_GPIO=y
CONFIG_SPI_SUN6I=y

#
# SPI Protocol Masters
#
CONFIG_SPI_SPIDEV=y

#
# PPS clients support
#

#
# PPS generators support
#

#
# PTP clock support
#
CONFIG_PTP_1588_CLOCK=y

#
# Enable PHYLIB and NETWORK_PHY_TIMESTAMPING to see the additional clocks.
#
# end of PTP clock support

CONFIG_PINCTRL=y
CONFIG_PINMUX=y
CONFIG_PINCONF=y
CONFIG_PINCTRL_SUNXI=y
CONFIG_PINCTRL_SUNIV_F1C100S=y
CONFIG_GPIO_SYSFS=y

#
# Memory mapped GPIO drivers
#
# end of Memory mapped GPIO drivers

#
# I2C GPIO expanders
#
# end of I2C GPIO expanders

#
# MFD GPIO expanders
#
# end of MFD GPIO expanders

#
# SPI GPIO expanders
#
# end of SPI GPIO expanders

#
# USB GPIO expanders
#
# end of USB GPIO expanders

CONFIG_POWER_SUPPLY=y
# CONFIG_HWMON is not set
CONFIG_THERMAL=y
CONFIG_CPU_THERMAL=y
CONFIG_WATCHDOG=y

#
# Watchdog Pretimeout Governors
#
# CONFIG_WATCHDOG_PRETIMEOUT_GOV is not set

#
# Watchdog Device Drivers
#
CONFIG_SUNXI_WATCHDOG=y

#
# USB-based Watchdog Cards
#

#
# Multifunction device drivers
#
CONFIG_MFD_AXP20X_I2C=y
CONFIG_MFD_AXP20X_RSB=y
CONFIG_MFD_SYSCON=y
# end of Multifunction device drivers

CONFIG_REGULATOR=y
CONFIG_REGULATOR_FIXED_VOLTAGE=y

#
# Multimedia core support
#

#
# Media drivers
#

#
# Supported MMC/SDIO adapters
#

#
# Media ancillary drivers (tuners, sensors, i2c, spi, frontends)
#

#
# I2C Encoders, decoders, sensors and other helper chips
#

#
# Audio decoders, processors and mixers
#

#
# RDS decoders
#

#
# Video decoders
#

#
# Video and audio decoders
#

#
# Video encoders
#

#
# Camera sensor devices
#

#
# Lens drivers
#

#
# Flash devices
#

#
# Video improvement chips
#

#
# Audio/Video compression chips
#

#
# SDR tuner chips
#

#
# Miscellaneous helper chips
#
# end of I2C Encoders, decoders, sensors and other helper chips

#
# SPI helper chips
#
# end of SPI helper chips

#
# Media SPI Adapters
#
# end of Media SPI Adapters

#
# Customise DVB Frontends
#

#
# Tools to develop new frontends
#
# end of Customise DVB Frontends

#
# Graphics support
#

#
# I2C encoder or helper chips
#
# end of I2C encoder or helper chips

#
# ARM devices
#
# end of ARM devices

#
# ACP (Audio CoProcessor) Configuration
#
# end of ACP (Audio CoProcessor) Configuration

#
# Display Panels
#
# end of Display Panels

#
# Display Interface Bridges
#
# end of Display Interface Bridges

#
# Frame buffer Devices
#

#
# Frame buffer hardware drivers
#
# end of Frame buffer Devices

#
# Backlight & LCD device support
#
CONFIG_LCD_CLASS_DEVICE=y
CONFIG_BACKLIGHT_CLASS_DEVICE=y
# CONFIG_BACKLIGHT_GENERIC is not set
CONFIG_BACKLIGHT_PWM=y
CONFIG_BACKLIGHT_GPIO=y
# end of Backlight & LCD device support

#
# Console display driver support
#
# end of Console display driver support
# end of Graphics support

CONFIG_SOUND=y
CONFIG_SND=y
CONFIG_SND_OSSEMUL=y
CONFIG_SND_MIXER_OSS=y
CONFIG_SND_PCM_OSS=y
# CONFIG_SND_DRIVERS is not set

#
# HD-Audio
#
# end of HD-Audio

# CONFIG_SND_SPI is not set
CONFIG_SND_SOC=y

#
# Allwinner SoC Audio support
#
CONFIG_SND_SUN4I_CODEC=y
CONFIG_SND_SUN4I_I2S=y
CONFIG_SND_SUN4I_SPDIF=y
# end of Allwinner SoC Audio support

CONFIG_SND_SIMPLE_CARD=y

#
# HID support
#

#
# Special HID drivers
#
CONFIG_HID_A4TECH=y
CONFIG_HID_APPLE=y
CONFIG_HID_BELKIN=y
CONFIG_HID_CHERRY=y
CONFIG_HID_CHICONY=y
CONFIG_HID_CYPRESS=y
CONFIG_HID_EZKEY=y
CONFIG_HID_ITE=y
CONFIG_HID_KENSINGTON=y
CONFIG_HID_LOGITECH=y
CONFIG_HID_REDRAGON=y
CONFIG_HID_MICROSOFT=y
CONFIG_HID_MONTEREY=y
CONFIG_USB_HIDDEV=y
CONFIG_USB=y
CONFIG_USB_ANNOUNCE_NEW_DEVICES=y

#
# Miscellaneous USB options
#
CONFIG_USB_DYNAMIC_MINORS=y
CONFIG_USB_OTG=y

#
# USB Host Controller Drivers
#
CONFIG_USB_EHCI_HCD=y
# CONFIG_USB_EHCI_TT_NEWSCHED is not set
CONFIG_USB_EHCI_HCD_PLATFORM=y
CONFIG_USB_OHCI_HCD=y
CONFIG_USB_OHCI_HCD_PLATFORM=y
CONFIG_NOP_USB_XCEIV=y

#
# USB Physical Layer drivers
#
# end of USB Physical Layer drivers

CONFIG_USB_GADGET=y
CONFIG_USB_GADGET_VBUS_DRAW=500
CONFIG_USB_MASS_STORAGE=y

#
# USB Peripheral Controller
#
# end of USB Peripheral Controller

CONFIG_USB_CONFIGFS=y
CONFIG_USB_CONFIGFS_SERIAL=y
CONFIG_USB_CONFIGFS_F_FS=y
CONFIG_MMC=y
CONFIG_PWRSEQ_EMMC=y
CONFIG_MMC_BLOCK=y
CONFIG_MMC_BLOCK_MINORS=8

#
# MMC/SD/SDIO Host Controller Drivers
#
CONFIG_MMC_SUNXI=y
CONFIG_DMADEVICES=y

#
# DMABUF options
#
CONFIG_SYNC_FILE=y
# end of DMABUF options

# CONFIG_VIRTIO_MENU is not set

#
# Common Clock Framework
#
CONFIG_CLK_SUNXI=y
CONFIG_CLK_SUNXI_CLOCKS=y
CONFIG_CLK_SUNXI_PRCM_SUN6I=y
CONFIG_CLK_SUNXI_PRCM_SUN8I=y
CONFIG_CLK_SUNXI_PRCM_SUN9I=y
CONFIG_SUNXI_CCU=y
CONFIG_SUN8I_A83T_CCU=y
CONFIG_SUN8I_DE2_CCU=y
CONFIG_SUN8I_R_CCU=y
# end of Common Clock Framework

# CONFIG_IOMMU_SUPPORT is not set

#
# Extcon Device Drivers
#
CONFIG_PWM=y
CONFIG_PWM_SUN4I=y
CONFIG_PHY_SUN4I_USB=y

# CONFIG_NVMEM is not set

#
# File systems
#
CONFIG_EXT4_FS=y
CONFIG_EXT4_USE_FOR_EXT2=y
CONFIG_AUTOFS4_FS=y

#
# Pseudo filesystems
#
CONFIG_TMPFS=y
CONFIG_TMPFS_POSIX_ACL=y

CONFIG_UBIFS_FS=y
CONFIG_SQUASHFS=y
# CONFIG_NETWORK_FILESYSTEMS is not set
CONFIG_NLS_CODEPAGE_437=y
CONFIG_NLS_ISO8859_1=y
# end of File systems

#
# Security options
#
CONFIG_KEYS=y

#
# Public-key cryptography
#
CONFIG_CRYPTO_RSA=y

#
# Authenticated Encryption with Associated Data
#
CONFIG_CRYPTO_CCM=y
CONFIG_CRYPTO_GCM=y
CONFIG_CRYPTO_ECHAINIV=y

#
# Hash modes
#
CONFIG_CRYPTO_CMAC=y

#
# Digest
#
CONFIG_CRYPTO_CRC32C=y

#
# Ciphers
#
CONFIG_CRYPTO_ARC4=y
CONFIG_CRYPTO_DES=y

#
# Random Number Generation
#
CONFIG_CRYPTO_DEV_SUN4I_SS=y
CONFIG_CRYPTO_DEV_SUN4I_SS_PRNG=y
CONFIG_ASYMMETRIC_KEY_TYPE=y
CONFIG_ASYMMETRIC_PUBLIC_KEY_SUBTYPE=y
CONFIG_X509_CERTIFICATE_PARSER=y
CONFIG_PKCS7_MESSAGE_PARSER=y

#
# Certificates for signature checking
#
CONFIG_SYSTEM_TRUSTED_KEYRING=y
# end of Certificates for signature checking

#
# Library routines
#
CONFIG_XZ_DEC=y
CONFIG_DMA_CMA=y

#
# Kernel hacking
#

#
# printk and dmesg options
#
CONFIG_PRINTK_TIME=y

#
# Compile-time checks and compiler options
#
CONFIG_DEBUG_FS=y
CONFIG_STACKTRACE=y

#
# RCU Debugging
#
CONFIG_RCU_TRACE=y
# end of RCU Debugging

# CONFIG_FTRACE is not set
# CONFIG_RUNTIME_TESTING_MENU is not set

#
# Platform Glue Layer
#
CONFIG_USB_MUSB_SUNXI=y

CONFIG_OF=y
CONFIG_CLKDEV_LOOKUP=y

#
# Default contiguous memory area size:
#
CONFIG_CMA_ALIGNMENT=8
CONFIG_CMA_AREAS=7
CONFIG_CMA_SIZE_MBYTES=16
CONFIG_CMA_SIZE_SEL_MBYTES=y
CONFIG_CLZ_TAB=y

#
# Clock Source drivers
#
CONFIG_CLKSRC_MMIO=y
# end of Clock Source drivers

#
# SCSI device support
#
CONFIG_SCSI_MOD=y
# CONFIG_RAID_ATTRS is not set
CONFIG_SCSI=y
CONFIG_SCSI_DMA=y
CONFIG_SCSI_PROC_FS=y

#
# SCSI support type (disk, tape, CD-ROM)
#
CONFIG_BLK_DEV_SD=y
CONFIG_CHR_DEV_SCH=y
CONFIG_CHR_DEV_SG=y

CONFIG_SCSI_LOWLEVEL=y
```
